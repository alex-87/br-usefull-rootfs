## defconfig
```kconfig
BR2_x86_64=y
BR2_OPTIMIZE_3=y
BR2_TOOLCHAIN_BUILDROOT_GLIBC=y
BR2_GCC_VERSION_7_X=y
BR2_TOOLCHAIN_BUILDROOT_CXX=y
BR2_GCC_ENABLE_LTO=y
BR2_GCC_ENABLE_OPENMP=y
BR2_INIT_NONE=y
BR2_ROOTFS_DEVICE_CREATION_STATIC=y
# BR2_TARGET_ENABLE_ROOT_LOGIN is not set
BR2_SYSTEM_BIN_SH_NONE=y
# BR2_TARGET_GENERIC_GETTY is not set
# BR2_TARGET_GENERIC_REMOUNT_ROOTFS_RW is not set
# BR2_PACKAGE_BUSYBOX is not set
BR2_PACKAGE_YAML_CPP=y
BR2_PACKAGE_GECODE=y
BR2_PACKAGE_PISTACHE=y
```

## external/Config.in
```kconfig
source "$BR2_EXTERNAL_USEFULLROOTFS_PATH/package/gecode/Config.in"
source "$BR2_EXTERNAL_USEFULLROOTFS_PATH/package/pistache/Config.in"
source "$BR2_EXTERNAL_USEFULLROOTFS_PATH/package/njson/Config.in"
source "$BR2_EXTERNAL_USEFULLROOTFS_PATH/package/cpppeglib/Config.in"
```

## external/package/cppkafka/Config.in
```kconfig
config BR2_PACKAGE_CPPKAFKA
	bool "cppkafka"
	select BR2_PACKAGE_LIBRDKAFKA
	help
	  High level C++ wrapper for rdkafka

	  https://github.com/mfontanini/cppkafka
```

## external/package/cpppeglib/Config.in
```kconfig
config BR2_PACKAGE_CPPPEGLIB
	bool "cpppeglib"
	help
	  Parsing Expression Grammars Library

	  https://github.com/yhirose/cpp-peglib
```

## external/package/gecode/Config.in
```kconfig
config BR2_PACKAGE_GECODE
	bool "gecode"
	select BR2_PACKAGE_MPFR
	help
	  The Gecode Library

	  https://www.gecode.org/
```

## external/package/librdkafka/Config.in
```kconfig
config BR2_PACKAGE_LIBRDKAFKA
	bool "librdkafka"
	select BR2_PACKAGE_BOOST
	help
	  The Apache Kafka C/C++ client library

	  https://github.com/edenhill/librdkafka
```

## external/package/njson/Config.in
```kconfig
config BR2_PACKAGE_NJSON
        bool "njson"
        help
          JSon for modern C++

          https://github.com/nlohmann/json
```

## external/package/nlohmannjson/Config.in
```kconfig
config BR2_PACKAGE_NJSON
        bool "lohmannjson"
        help
          JSon for modern C++

          https://github.com/nlohmann/json
```

## external/package/pistache/Config.in
```kconfig
config BR2_PACKAGE_PISTACHE
	bool "pistache"
	help
	  The Pitache Library

	  https://github.com/oktal/pistache
```
